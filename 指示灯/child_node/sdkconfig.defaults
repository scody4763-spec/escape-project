## 指示灯/child_node/sdkconfig.defaults
```kconfig
# CPU 240MHz
CONFIG_ESP_DEFAULT_CPU_FREQ_MHZ_240=y

# Flash 8MB QIO 80MHz
CONFIG_ESPTOOLPY_FLASHSIZE_8MB=y
CONFIG_ESPTOOLPY_FLASHMODE_QIO=y
CONFIG_ESPTOOLPY_FLASHFREQ_80M=y

# Custom partition table
CONFIG_PARTITION_TABLE_CUSTOM=y
CONFIG_PARTITION_TABLE_CUSTOM_FILENAME="partitions.csv"

# FreeRTOS tick rate 1000Hz (1ms)
CONFIG_FREERTOS_HZ=1000

# Enable WiFi
CONFIG_ESP_WIFI_ENABLED=y

# Enable ESP Mesh
CONFIG_ESP_WIFI_ESPNOW_MAX_ENCRYPT_NUM=0

# Stack sizes
CONFIG_ESP_MAIN_TASK_STACK_SIZE=8192
CONFIG_ESP_SYSTEM_EVENT_TASK_STACK_SIZE=4096

# Log level
CONFIG_LOG_DEFAULT_LEVEL_INFO=y

# Enable cJSON
CONFIG_CJSON_ENABLED=y

# Increase watchdog timeout
CONFIG_ESP_TASK_WDT_TIMEOUT_S=30
CONFIG_ESP_TASK_WDT_PANIC=n
```

## 指示灯/master_node/sdkconfig.defaults
```kconfig
# CPU 240MHz
CONFIG_ESP_DEFAULT_CPU_FREQ_MHZ_240=y

# Flash 8MB QIO 80MHz
CONFIG_ESPTOOLPY_FLASHSIZE_8MB=y
CONFIG_ESPTOOLPY_FLASHMODE_QIO=y
CONFIG_ESPTOOLPY_FLASHFREQ_80M=y

# Custom partition table
CONFIG_PARTITION_TABLE_CUSTOM=y
CONFIG_PARTITION_TABLE_CUSTOM_FILENAME="partitions.csv"

# FreeRTOS tick rate 1000Hz (1ms)
CONFIG_FREERTOS_HZ=1000

# Enable WiFi
CONFIG_ESP_WIFI_ENABLED=y

# Enable ESP Mesh
CONFIG_ESP_WIFI_ESPNOW_MAX_ENCRYPT_NUM=0

# Stack sizes
CONFIG_ESP_MAIN_TASK_STACK_SIZE=8192
CONFIG_ESP_SYSTEM_EVENT_TASK_STACK_SIZE=4096

# Log level
CONFIG_LOG_DEFAULT_LEVEL_INFO=y

# Enable cJSON
CONFIG_CJSON_ENABLED=y

# Increase watchdog timeout
CONFIG_ESP_TASK_WDT_TIMEOUT_S=30
CONFIG_ESP_TASK_WDT_PANIC=n

# BLE (NimBLE - 低功耗蓝牙, 不可连接广播)
CONFIG_BT_ENABLED=y
# CONFIG_BT_BLUEDROID_ENABLED is not set
CONFIG_BT_NIMBLE_ENABLED=y
CONFIG_BT_CONTROLLER_ENABLED=y
# CONFIG_BT_CONTROLLER_DISABLED is not set
CONFIG_BT_NIMBLE_MEM_ALLOC_MODE_INTERNAL=y
CONFIG_BT_NIMBLE_HOST_TASK_STACK_SIZE=4096
CONFIG_BT_NIMBLE_LEGACY_VHCI_ENABLE=y
# CONFIG_BT_NIMBLE_ROLE_CENTRAL is not set
# CONFIG_BT_NIMBLE_ROLE_PERIPHERAL is not set
CONFIG_BT_NIMBLE_ROLE_BROADCASTER=y
# CONFIG_BT_NIMBLE_ROLE_OBSERVER is not set
# CONFIG_BT_NIMBLE_SECURITY_ENABLE is not set
CONFIG_BT_NIMBLE_MAX_CCCDS=0
```
